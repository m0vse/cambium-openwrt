// SPDX-License-Identifier: GPL-2.0-or-later OR MIT
/dts-v1/;

#include "qcom-ipq4019-e410.dtsi"

/ {
	model = "Cambium Networks E410B";
	compatible = "cambiumnetworks,e410b", "qcom,ipq4019";

	cambium-platform {
		compatible = "cambium-platform";
		board-sku = <21>;
	};
};
