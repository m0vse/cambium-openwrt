// SPDX-License-Identifier: GPL-2.0-or-later OR MIT
/dts-v1/;

#include "qcom-ipq4019-e410.dtsi"

/ {
	model = "Cambium Networks E410";
	compatible = "cambium,e410", "cambiumnetworks,e410", "qcom,ipq4019";

	cambium-platform {
		compatible = "cambium-platform";
		board-sku = <10>;
	};
};
