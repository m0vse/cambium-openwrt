// SPDX-License-Identifier: (GPL-2.0-only OR BSD-2-Clause)
/*
 * Persistent OpenWrt in NAND bank 0 (rootfs) beside the OEM firmware: that
 * bank and 0:APPSBLENV (for the cambium-ab boot guard) are writable; the OEM
 * bank rootfs_1 and every other partition stay read-only.
 */
#include "ipq5332-x7-35x-recovery.dts"

&miami_rootfs {
	/delete-property/ read-only;
};

&miami_appsblenv {
	/delete-property/ read-only;
};
