// SPDX-License-Identifier: GPL-2.0-or-later OR MIT

/* Test tree: the A/B persistent tree for bank 0 with the scanning radio. */
#include "ipq8074-xv3-8-persistent.dts"
#include "ipq8074-xv3-8-scan-radio.dtsi"
