// SPDX-License-Identifier: GPL-2.0-or-later OR MIT

/* OEM mp03.3-lynx differs from XV2-21X mp03.3-ocelot only by board SKU. */
#include "ipq5018-xv2-21x.dts"

/ {
	model = "Cambium Networks XV2-23T";
	compatible = "cambiumnetworks,xv2-23t", "qcom,ipq5018";

	cambium-platform {
		board-sku = <36>;
	};
};

/* OEM 7.2-r1 uses b24-lynx and b60.stock, imported from the retained bank. */
&wifi {
	status = "okay";
	qcom,ath11k-calibration-variant = "Cambium-XV2-23T";
};

&wifi1 {
	status = "okay";
	qcom,ath11k-calibration-variant = "Cambium-XV2-23T-5G";
};
