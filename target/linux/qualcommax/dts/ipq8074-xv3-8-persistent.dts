// SPDX-License-Identifier: GPL-2.0-or-later OR MIT

/*
 * Thor A/B persistent tree for bank 0 (config@hk02): both 96 MiB firmware
 * banks and the U-Boot environment are writable, and the root is appended
 * here, as on the validated single-bank installs, so their committed boot
 * command keeps working. ipq8074-xv3-8-persistent-bank1.dts is the same tree
 * rooted in bank 1. ART, 0:ETHPHYFW and the other NOR partitions stay
 * read-only.
 */
#include "ipq8074-xv3-8-installer.dts"

&rootfs_1 {
	/delete-property/ read-only;
};
