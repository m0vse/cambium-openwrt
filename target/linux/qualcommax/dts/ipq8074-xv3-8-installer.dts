// SPDX-License-Identifier: GPL-2.0-or-later OR MIT

/*
 * Thor RAM installer: OpenWrt goes into rootfs, so only rootfs and the U-Boot
 * environment (for the guarded first boot) are writable. rootfs_1 keeps the
 * stock firmware read-only.
 */
#include "ipq8074-xv3-8.dts"

/ {
	model = "Cambium Networks XV3-8";

	chosen {
		bootargs-append = " ubi.mtd=rootfs root=/dev/ubiblock0_1 rootfstype=squashfs rootwait";
	};
};

&rootfs {
	/delete-property/ read-only;
};

&appsblenv {
	/delete-property/ read-only;
};
