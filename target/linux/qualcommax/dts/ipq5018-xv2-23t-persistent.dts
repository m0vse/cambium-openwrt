// SPDX-License-Identifier: GPL-2.0-or-later OR MIT

/*
 * Persistent XV2-23T image. The flash layout, OpenWrt slot and guarded boot
 * match the hardware-validated XV2-21X persistent image; this model itself
 * has not been installed persistently yet.
 */
#include "ipq5018-xv2-23t-recovery.dts"

/ {
	chosen {
		bootargs-append = " swiotlb=1 coherent_pool=2M ubi.mtd=rootfs root=/dev/ubiblock0_1 rootfstype=squashfs rootwait";
	};
};

/* rootfs_1 remains the OEM fallback; only the OpenWrt slot is writable. */
&rootfs {
	/delete-property/ read-only;
};

/* Linux rearms the guarded boot only after network and radio checks pass. */
&appsblenv {
	/delete-property/ read-only;
};
