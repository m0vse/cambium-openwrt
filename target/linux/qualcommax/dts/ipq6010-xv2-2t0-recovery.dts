// SPDX-License-Identifier: (GPL-2.0+)

/* OEM 7.2-r1 XV2-2T0 and XV2-2T1 trees differ only in board-sku. */
#include "ipq6010-xv2-2t1-recovery.dts"

/ {
	model = "Cambium Networks XV2-2T0";
	compatible = "cambiumnetworks,xv2-2t0", "qcom,ipq6018-ap-cp01-c1",
		     "qcom,ipq6018-ap-cp01", "qcom,ipq6018";

	cambium-platform {
		board-sku = <22>;
	};
};

/* Best-effort radio enablement; this model's board data is unqualified. */
&wifi {
	status = "okay";
	qcom,ath11k-calibration-variant = "Cambium-XV2-2T0";
};
